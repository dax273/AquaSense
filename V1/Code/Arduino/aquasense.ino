#include <Wire.h>
#include <DHT.h>
#include <Adafruit_GFX.h>
#include <Adafruit_SSD1306.h>

// ---------------- DHT ----------------
#define DHTPIN 2
#define DHTTYPE DHT22
DHT dht(DHTPIN, DHTTYPE);

// ---------------- ULTRASONIC ----------------
#define TRIG_PIN 4
#define ECHO_PIN 3

// ---------------- TDS ----------------
#define TDS_PIN A0
float tdsValue = 0;

// ---------------- TANK HEIGHT ----------------
#define TANK_HEIGHT 200

// ---------------- OLED ----------------
#define SCREEN_WIDTH 128
#define SCREEN_HEIGHT 64
Adafruit_SSD1306 display(SCREEN_WIDTH, SCREEN_HEIGHT, &Wire, -1);

// ---------------- LOGO BITMAP ----------------
// AquaSense logo — 128x64px, white on black, clean (no artifacts)
const unsigned char logo_bmp[] PROGMEM = {
  0x00, 0x00, 0x00, 0x00, 0x00, 0x00, 0x00, 0x00, 0x00, 0x00, 0x00, 0x00, 0x00, 0x00, 0x00, 0x00,
  0x00, 0x00, 0x00, 0x00, 0x00, 0x00, 0x00, 0x00, 0x00, 0x00, 0x00, 0x00, 0x00, 0x00, 0x00, 0x00,
  0x00, 0x00, 0x00, 0x00, 0x00, 0x00, 0x00, 0x00, 0x00, 0x00, 0x00, 0x00, 0x00, 0x00, 0x00, 0x00,
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  0x00, 0x00, 0x00, 0x00, 0x00, 0x00, 0x00, 0x00, 0x00, 0x00, 0x00, 0x00, 0x00, 0x00, 0x00, 0x00
};

// ---------------- VARIABLES ----------------
unsigned long lastDHT = 0;

float humidity = 0;
float temperature = 0;
float distance = -1;
float waterDepth = -1;

// ---------------- ULTRASONIC ----------------
float readUltrasonic() {

  float sum = 0;
  int validReadings = 0;

  for (int i = 0; i < 5; i++) {

    digitalWrite(TRIG_PIN, LOW);
    delayMicroseconds(2);

    digitalWrite(TRIG_PIN, HIGH);
    delayMicroseconds(10);
    digitalWrite(TRIG_PIN, LOW);

    long duration = pulseIn(ECHO_PIN, HIGH, 20000);

    if (duration > 0) {
      float d = duration * 0.034 / 2;

      if (d >= 2 && d <= 400) {
        sum += d;
        validReadings++;
      }
    }

    delay(10);
  }

  if (validReadings == 0) {
    return -1;
  }

  return sum / validReadings;
}

// ---------------- TDS ----------------
float readTDS() {
  int raw = analogRead(TDS_PIN);
  float voltage = raw * (5.0 / 1024.0);

  float compensation = 1.0 + 0.02 * (temperature - 25.0);

  float ec = (133.42 * voltage * voltage * voltage
             - 255.86 * voltage * voltage
             + 857.39 * voltage) * compensation;

  float tds = ec * 0.5;

  return tds;
}

// ---------------- SETUP ----------------
void setup() {
  Serial.begin(9600);

  dht.begin();

  pinMode(TRIG_PIN, OUTPUT);
  pinMode(ECHO_PIN, INPUT);
  pinMode(TDS_PIN, INPUT);

  if (!display.begin(SSD1306_SWITCHCAPVCC, 0x3C)) {
    while (true);
  }

  // ---- BOOT SPLASH: AquaSense logo for 2 seconds ----
  display.clearDisplay();
  display.drawBitmap(0, 0, logo_bmp, 128, 64, WHITE);
  display.display();
  delay(2000);
  display.clearDisplay();
  display.display();
  // ---- END SPLASH ----

  display.setTextSize(1);
  display.setTextColor(WHITE);
}

// ---------------- LOOP ----------------
void loop() {

  // Read distance
  distance = readUltrasonic();

  // Convert to depth
  if (distance >= 0) {
    waterDepth = TANK_HEIGHT - distance;
  } else {
    waterDepth = -1;
  }

  // DHT update every 2 sec
  if (millis() - lastDHT > 2000) {
    float h = dht.readHumidity();
    float t = dht.readTemperature();

    if (!isnan(h) && !isnan(t)) {
      humidity = h;
      temperature = t;
    }

    lastDHT = millis();
  }

  // Read TDS
  tdsValue = readTDS();

  // ---------------- SERIAL OUTPUT ----------------
  Serial.print(humidity);
  Serial.print(",");
  Serial.print(temperature);
  Serial.print(",");
  Serial.print(waterDepth);
  Serial.print(",");
  Serial.println(tdsValue);

  // ---------------- OLED DISPLAY ----------------
  display.clearDisplay();

  display.setCursor(0, 0);
  display.print("Humidity    : ");
  display.println(humidity);

  display.setCursor(0, 16);
  display.print("Temperature : ");
  display.println(temperature);

  display.setCursor(0, 32);
  display.print("Depth       : ");
  display.println(waterDepth);

  display.setCursor(0, 48);
  display.print("TDS         : ");
  display.println(tdsValue);

  display.display();

  delay(200);
}
